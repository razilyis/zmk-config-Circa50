## config/boards/shields/circa50/Kconfig.defconfig
```kconfig
if SHIELD_CIRCA50_LEFT || SHIELD_CIRCA50_RIGHT

config ZMK_KEYBOARD_NAME
    default "Circa50"

config ZMK_SPLIT
    default y

endif

if SHIELD_CIRCA50_RIGHT

config ZMK_SPLIT_ROLE_CENTRAL
    default y

config ZMK_POINTING
    default y

endif
```

## config/boards/shields/circa50/Kconfig.shield
```kconfig
config SHIELD_CIRCA50_LEFT
    def_bool $(shields_list_contains,circa50_left)

config SHIELD_CIRCA50_RIGHT
    def_bool $(shields_list_contains,circa50_right)
```
